## conf/distro/kkdistro.conf
```bitbake
DISTRO = "kkdistro"
DISTRO_NAME = "Dard E Disco"
DISTRO_VERSION = "1.0"
DISTRO_CODENAME = "wrynose"

PACKAGE_CLASSES ?= "package_rpm"

SANITY_TESTED_DISTROS ?= " \
            poky-6.0 \n \
            ubuntu-22.04 \n \
            ubuntu-24.04 \n \
            ubuntu-26.04 \n \
"

KERNEL_EXTRA_FEATURES:append = " features/debug/debug-kernel.scc"
```

## conf/layer.conf
```bitbake
# We have a conf and classes directory, add to BBPATH
BBPATH .= ":${LAYERDIR}"

# We have a packages directory, add to BBFILES
BBFILES += "${LAYERDIR}/recipes-*/*/*.bb \
            ${LAYERDIR}/recipes-*/*/*.bbappend"

BBFILE_COLLECTIONS += "eaton"
BBFILE_PATTERN_eaton := "^${LAYERDIR}/"
BBFILE_PRIORITY_eaton = "4"
LAYERSERIES_COMPAT_eaton = "wrynose"

TI_COMMON_DEPLOY ?= "${TOPDIR}/tmp/deploy"
DEPLOY_DIR_IMAGE:ti-soc = "${TI_COMMON_DEPLOY}/images/${MACHINE}"

LICENSE_PATH += "${LAYERDIR}/licenses"
```

## conf/machine/haridwar-k3r5.conf
```bitbake
#@TYPE: Machine
#@NAME: Haridwar Board BSP
#@SOC: AM62x
#@DESCRIPTION: Machine configuration for Haridwar board

require conf/machine/include/k3r5.inc

SYSFW_SOC = "am62x"
SYSFW_CONFIG = "evm"

PREFERRED_PROVIDER_virtual/bootloader = "u-boot"
PREFERRED_PROVIDER_u-boot = "u-boot"
```

## conf/machine/haridwar.conf
```bitbake
#@TYPE: Machine
#@NAME: Haridwar Board BSP
#@SOC: AM62x
#@DESCRIPTION: Machine configuration for Haridwar board

require conf/machine/include/am62xx.inc

KERNEL_DEVICETREE_PREFIX = " \
    ti/k3-am625 \
    ti/k3-am62x-sk \
"

KERNEL_DEVICETREE = " \
    ti/k3-am625-sk.dtb \
"

PREFERRED_PROVIDER_virtual/bootloader = "u-boot"
PREFERRED_PROVIDER_u-boot = "u-boot"

FIT_CONF_DEFAULT_DTB = "k3-am625-sk.dtb"

UBOOT_MACHINE = "am62x_evm_a53_defconfig"

WKS_FILE = "sdimage-squashfs.wks.in"

DISTRO_FEATURES:remove = "3g \
            irda \
            nfc \
            zeroconf \
            3g \
            bluetooth \
            nfc \
            nfs \
            gnome-desktop-testing \
            python-setuptools \
            python3-core \
            qemu"
```
